/*
 * Copyright (C) 2017 Texas Instruments Incorporated - http://www.ti.com/
 *
 * This program is free software; you can redistribute it and/or modify
 * it under the terms of the GNU General Public License version 2 as
 * published by the Free Software Foundation.
 */
#include "dra71-evm.dts"

#include "dra7-ipu-common-early-boot.dtsi"
#include "dra7-dsp-common-early-boot.dtsi"


